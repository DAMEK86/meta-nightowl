## conf/distro/nightowl-tiny.conf
```bitbake
require conf/distro/poky.conf

MAINTAINER = "Andreas Rehn <rehn.andreas86@gmail.com>"
DISTRO = "nightowl-tiny"
DISTRO_NAME = "nightowl (Built on Yocto ${DISTRO_VERSION})"

DISTRO_FEATURES_DEFAULT_remove = " \
  3g \
  alsa \
  bluetooth \
  directfb \
  egl \
  ipv6 \
  nfc \
  nfs \
  opengl \
  opengles \
  pci \
  pcmcia \
  ppp \
  pulseaudio \
  smbfs \
  systemd \
  usbhost \
  vfat \
  wayland \
  wifi \
  xcb \
  x11 \
  zeroconf \
"

DISTRO_FEATURES_remove = "ptest"

# no root password
EXTRA_IMAGE_FEATURES = "debug-tweaks"

INHERIT += " \
    buildstats \
    buildhistory \
"

TCLIBC = "musl"
INIT_MANAGER = "mdev-busybox"
```

## conf/distro/nightowl.conf
```bitbake
require conf/distro/poky.conf

MAINTAINER = "Andreas Rehn <rehn.andreas86@gmail.com>"
DISTRO = "nightowl"
DISTRO_NAME = "nightowl (Built on Yocto ${DISTRO_VERSION})"

DISTRO_FEATURES_DEFAULT:remove = " \
  3g \
  bluetooth \
  ipv6 \
  nfc \
  nfs \
  pci \
  pcmcia \
  ppp \
  pulseaudio \
  smbfs \
  systemd \
  usbhost \
  vfat \
  wayland \
  wifi \
  xcb \
  zeroconf \
"

DISTRO_FEATURES += "alsa directfb x11 opengl"

DISTRO_FEATURES:remove = "ptest wayland"

# no root password
EXTRA_IMAGE_FEATURES = "debug-tweaks"

INHERIT += " \
    buildstats \
    buildhistory \
"
```

## conf/layer.conf
```bitbake
# We have a conf and classes directory, add to BBPATH
BBPATH .= ":${LAYERDIR}"

# We have recipes-* directories, add to BBFILES
BBFILES += "${LAYERDIR}/recipes-*/*/*.bb \
            ${LAYERDIR}/recipes-*/*/*.bbappend"

BBFILE_COLLECTIONS += "nightowl-layer"
BBFILE_PATTERN_nightowl-layer = "^${LAYERDIR}/"

BBFILE_PRIORITY_nightowl-layer = "15"

LAYERSERIES_COMPAT_nightowl-layer = "kirkstone"

BBFILES_DYNAMIC += " \
    qt5-layer:${LAYERDIR}/dynamic-layers/qt5/recipes-*/*/*.bb \
    qt5-layer:${LAYERDIR}/dynamic-layers/qt5/recipes-*/*/*.bbappend \
    lichee-bsp:${LAYERDIR}/dynamic-layers/lichee/recipes-*/*/*.bb \
    lichee-bsp:${LAYERDIR}/dynamic-layers/lichee/recipes-*/*/*.bbappend \
"


# default version is 3.5 since 4.1.8 has problems with raw data sockets
PREFERRED_VERSION_ser2net = "3.5"
```
